/*
 * @Author: error: error: git config user.name & please set dead value or install git && error: git config user.email & please set dead value or install git & please set dead value or install git
 * @Date: 2026-04-10 10:35:50
 * @LastEditors: popcorn shenyuxiang4924@gmail.com
 * @LastEditTime: 2026-05-31 16:42:49
 * @FilePath: \MDK-ARM\OLED.c
 * @Description: 这是默认设置,请设置`customMade`, 打开koroFileHeader查看配置 进行设置: https://github.com/OBKoro1/koro1FileHeader/wiki/%E9%85%8D%E7%BD%AE
 */
#include "OLED.h"
#include "gpio.h"
#include "spi.h"
#include <stdio.h>
#include <stdarg.h>

#define hspi &hspi1

#define OLED_CMD 0  // 写命令
#define OLED_DATA 1 // 写数据
#define OLED_RES_Clr() HAL_GPIO_WritePin(GPIOC, GPIO_PIN_4, GPIO_PIN_RESET)
#define OLED_RES_Set() HAL_GPIO_WritePin(GPIOC, GPIO_PIN_4, GPIO_PIN_SET)
#define OLED_DC_Clr() HAL_GPIO_WritePin(GPIOC, GPIO_PIN_5, GPIO_PIN_RESET)
#define OLED_DC_Set() HAL_GPIO_WritePin(GPIOC, GPIO_PIN_5, GPIO_PIN_SET)
#define OLED_CS_Clr() HAL_GPIO_WritePin(GPIOB, GPIO_PIN_0, GPIO_PIN_RESET)
#define OLED_CS_Set() HAL_GPIO_WritePin(GPIOB, GPIO_PIN_0, GPIO_PIN_SET)

static uint8_t OLED_GRAM[8][128] = {0}; // OLED显存
const uint8_t font[190][8] = {
    {0x00, 0x00, 0x00, 0x00, 0x00, 0x00, 0x00, 0x00},
    {0x00, 0x00, 0x00, 0x00, 0x00, 0x00, 0x00, 0x00}, /*" ",0*/

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    {0x00, 0x00, 0x00, 0x00, 0x00, 0x00, 0x00, 0x00}, /*"~",94*/

};

/**
 * @description: 向OLED写入一个字节数据/命令
 * @return {*}
 */
void OLED_WR_Byte(uint8_t dat, uint8_t cmd)
{

    // 根据cmd参数配置DC引脚（数据/命令选择）
    if (cmd)
    {
        OLED_DC_Set(); // 置1：表示写入数据
    }
    else
    {
        OLED_DC_Clr(); // 置0：表示写入命令
    }

    OLED_CS_Clr(); // 拉低CS引脚，使能OLED芯片（片选）

    HAL_SPI_Transmit(hspi, &dat, 1, HAL_MAX_DELAY); // 使用SPI发送数据

    OLED_CS_Set(); // 拉高CS引脚，取消片选
    OLED_DC_Set(); // 恢复DC引脚为数据状态（默认）
}

void OLED_WR_Bytes(uint8_t *pData, uint16_t Size)
{
    OLED_DC_Set(); // 置1：表示写入数据
    OLED_CS_Clr(); // 拉低CS引脚，使能OLED芯片（片选）

    HAL_SPI_Transmit(hspi, pData, Size, HAL_MAX_DELAY); // 使用SPI发送数据

    OLED_CS_Set(); // 拉高CS引脚，取消片选
    OLED_DC_Set(); // 恢复DC引脚为数据状态（默认）
}

/**
 * @description: OLED清屏函数，将OLED显示内容全部清空
 * @return {*}
 */
void OLED_Clear(void)
{
    uint8_t i, n;
    for (i = 0; i < 8; i++)
    {
        OLED_WR_Byte(0xb0 + i, OLED_CMD); // 设置页地址
        OLED_WR_Byte(0x00, OLED_CMD);     // 设置列地址低4位
        OLED_WR_Byte(0x10, OLED_CMD);     // 设置列地址高4位
        for (n = 0; n < 128; n++)
        {
            OLED_GRAM[i][n] = 0x00; // 清空当前页的所有列数据
        }
    }
}

void OLED_Clearline(uint8_t line)
{
    uint8_t i, n;
    for (i = line * 2; i < line * 2 + 2; i++)
    {
        OLED_WR_Byte(0xb0 + i, OLED_CMD); // 设置页地址
        OLED_WR_Byte(0x00, OLED_CMD);     // 设置列地址低4位
        OLED_WR_Byte(0x10, OLED_CMD);     // 设置列地址高4位
        for (n = 0; n < 128; n++)
        {
            OLED_GRAM[i][n] = 0x00; // 清空当前页的所有列数据
        }
    }
}

/**
 * @description: OLED初始化函数，配置OLED显示屏的基本参数并清屏
 * @return {*}
 */
void OLED_Init(void)
{
    // OLED 复位
    OLED_RES_Clr(); // RES 置 0
    HAL_Delay(200); // 延时 200ms
    OLED_RES_Set(); // RES 置 1
    HAL_Delay(200); // 延时 200ms

    // OLED 初始化
    OLED_WR_Byte(0xAE, OLED_CMD); //--turn off oled panel
    OLED_WR_Byte(0x00, OLED_CMD); //---set low column address
    OLED_WR_Byte(0x10, OLED_CMD); //---set high column address
    OLED_WR_Byte(0x40, OLED_CMD); //--set start line address
    OLED_WR_Byte(0x81, OLED_CMD); //--set contrast control register
    OLED_WR_Byte(0xCF, OLED_CMD); // Set SEG Output Current Brightness
    OLED_WR_Byte(0xA1, OLED_CMD); //--Set SEG/Column Mapping     0xa0 左右反置 0xa1 正常
    OLED_WR_Byte(0xC8, OLED_CMD); // Set COM/Row Scan Direction   0xc0 上下反置 0xc8 正常
    OLED_WR_Byte(0xA6, OLED_CMD); //--set normal display
    OLED_WR_Byte(0xA8, OLED_CMD); //--set multiplex ratio(1 to 64)
    OLED_WR_Byte(0x3f, OLED_CMD); //--1/64 duty
    OLED_WR_Byte(0xD3, OLED_CMD); //-set display offset    Shift    Mapping    RAM Counter (0x00~0x3F)
    OLED_WR_Byte(0x00, OLED_CMD); //-not offset
    OLED_WR_Byte(0xd5, OLED_CMD); //--set display clock divide ratio/oscillator frequency
    OLED_WR_Byte(0x80, OLED_CMD); //--set divide ratio, Set Clock as 100 Frames/Sec
    OLED_WR_Byte(0xD9, OLED_CMD); //--set pre-charge period
    OLED_WR_Byte(0xF1, OLED_CMD); // Set Pre-Charge as 15 Clocks & Discharge as 1 Clock
    OLED_WR_Byte(0xDA, OLED_CMD); //--set com pins hardware configuration
    OLED_WR_Byte(0x12, OLED_CMD);
    OLED_WR_Byte(0xDB, OLED_CMD); //--set vcomh
    OLED_WR_Byte(0x30, OLED_CMD); // Set VCOM Deselect Level
    OLED_WR_Byte(0x20, OLED_CMD); //-Set Page Addressing Mode (0x00/0x01/0x02)
    OLED_WR_Byte(0x02, OLED_CMD); //
    OLED_WR_Byte(0x8D, OLED_CMD); //--set Charge Pump enable/disable
    OLED_WR_Byte(0x14, OLED_CMD); //--set(0x10) disable
    OLED_WR_Byte(0xA4, OLED_CMD); // Disable Entire Display On (0xa4/0xa5)
    OLED_WR_Byte(0xAF, OLED_CMD);

    OLED_Clear();
    OLED_Map();
}

void OLED_Map(void)
{
    for (int i = 0; i < 8; i++)
    {
        OLED_WR_Byte(0xb0 + i, OLED_CMD); // 设置页地址
        OLED_WR_Byte(0x00, OLED_CMD);     // 设置列地址低4位
        OLED_WR_Byte(0x10, OLED_CMD);     // 设置列地址高4位
        OLED_WR_Bytes(OLED_GRAM[i], 128); // 将OLED_GRAM数组中的数据写入当前页的所有列
    }
}

/**
 * @description: 在OLED上绘制一个字符
 * @param {uint8_t} x行坐标（0-3）
 * @param {uint8_t} y列坐标（0-15）
 * @param {uint8_t} chr字符
 * @return {*}
 */
void OLED_DrawChar(uint8_t x, uint8_t y, uint8_t chr)
{
    for (int i = 2 * x; i < 2 * x + 2; i++)
    {
        for (int j = y * 8; j < y * 8 + 8; j++)
        {
            OLED_GRAM[i][j] = font[(chr - 32) * 2 + i - 2 * x][j - y * 8];
        }
    }
}

void OLED_DrawOnlyString(uint8_t x, uint8_t y, char *str)
{
    while (*str != '\0')
    {
        if (*str == '\n')
        {
            x++;
            y = 0;
            str++;
            continue;
        }

        OLED_DrawChar(x, y, *str);
        str++;
        y++;

        if (y >= 16)
        {
            x++;
            y = 0;
        }

        if (x >= 4)
        {
            break;
        }
    }
}

void OLED_DrawString(uint8_t x, uint8_t y, const char *fmt, ...)
{
    char buf[65]; // OLED 最多 4 行 * 16 字符 = 64 字符
    va_list args;

    va_start(args, fmt);
    vsnprintf(buf, sizeof(buf), fmt, args);
    va_end(args);

    char *str = buf;

    while (*str != '\0')
    {
        if (*str == '\n')
        {
            x++;
            y = 0;
            str++;
            continue;
        }

        OLED_DrawChar(x, y, *str);
        str++;
        y++;

        if (y >= 16)
        {
            x++;
            y = 0;
        }

        if (x >= 4)
        {
            break;
        }
    }
}
